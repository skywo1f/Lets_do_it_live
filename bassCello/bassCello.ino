#include <FastLED.h>
#define LED_PIN     7
#define NUM_LEDS    300
CRGB leds[NUM_LEDS];
int tempo = 500;

typedef struct {
    int coord;
    int tab;
} note;    //  creates a struct type dataNode

const int songLength = 654;
//note mySong[songLength] =  {{0, 3},{0, 5}, {1,2},{1,3},{1,5},{2,2},{2,4},{2,5}};
note mySong[songLength] = {{0 , 3},{1 ,5 },{3 ,4 },{2 ,7 },{3 ,4 },{1 ,5 },{3 ,4 },{1 ,5 },{0 ,3 },{1 ,5 },{3 ,4 },{2 ,7 },{3 ,4 },{1 ,5 },{3 ,4 },{1 ,5 },{0 ,3 },{2 ,2 },{3 ,5 },{3 ,4 },{3 ,5 },{2 ,2 },{3 ,5 },{2 ,2 },{0 ,3 },{2 ,2 },{3 ,5 },{3 ,4 },{3 ,5 },{2 ,2 },{3 ,5 },{2 ,2 },
                           {0 ,3 },{2 ,4 },{3 ,5 },{3 ,4 },{3 ,5 },{2 ,4 },{3 ,5 },{2 ,4 },{0 ,3 },{2 ,4 },{3 ,5 },{3 ,4 },{3 ,5 },{2 ,4 },{3 ,5 },{2 ,4 },{0 ,3 },{2 ,5 },{3 ,4 },{2 ,7 },{3 ,4 },{2 ,5 },{3 ,4 },{2 ,5 },{0 ,3 },{2 ,5 },{3 ,4 },{2 ,7 },{3 ,4 },{2 ,5 },{3 ,4 },{2 ,4 },
                           {0 ,3 },{2 ,2 },{3 ,4 },{3 ,2 },{3 ,4 },{2 ,5 },{2 ,4 },{2 ,5 },{2 ,2 },{2 ,5 },{2 ,4 },{2 ,5 },{1 ,2 },{1 ,5 },{1 ,4 },{1 ,2 },{1 ,4 },{2 ,5 },{3 ,2 },{2 ,5 },{3 ,2 },{2 ,5 },{3 ,2 },{2 ,5 },{1 ,4 },{2 ,5 },{3 ,2 },{2 ,5 },{3 ,2 },{2 ,5 },{3 ,2 },{2 ,5 },
                           {2 ,4 },{2 ,7 },{3 ,7 },{3 ,6 },{3 ,7 },{2 ,7 },{2 ,5 },{2 ,7 },{2 ,4 },{2 ,7 },{2 ,5 },{2 ,7 },{1 ,5 },{2 ,4 },{1 ,7 },{1 ,5 },{0 ,0 },{1 ,2 },{2 ,5 },{2 ,4 },{2 ,5 },{1 ,2 },{2 ,5 },{1 ,2 },{0 ,0 },{2 ,2 },{2 ,5 },{2 ,4 },{2 ,5 },{2 ,2 },{2 ,5 },{2 ,2 },
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                           {3 ,11 },{2 ,10 },{0 ,10 },{2 ,10 },{3 ,11 },{2 ,10 },{3 ,11 },{2 ,10 },{3 ,11 },{2 ,10 },{0 ,10 },{2 ,10 },{3 ,11 },{2 ,10 },{3 ,11 },{2 ,10 },{2 ,9 }   //short line
};



//note mySong[songLength] =  {{3, 15},{3, 14}, {3,13},{3,12},{3,11},{3,10},{3,9},{3,8},{3, 7},{3, 6}, {3,5},{3,4},{3,3},{3,2},{3,1},{3,0}};

int ledsPerLayer[] =  {6,6 ,5,5,5,5,5,5,5,5,5,4,4,4,4,4};
int ledsInBetween[] = {6,10,9,9,9,9,9,3,9,9,8,9,9,9,9,2};

int sumUp(int coord, int tab){
  int thisLayer = 15 - tab;
  int index = 0;  
  for (int i = 0; i < thisLayer; i++) {
    int ledsThisTab = ledsPerLayer[i];
    int betweenThisTab = ledsInBetween[i];
    index = index + ledsThisTab + betweenThisTab;
  }
  index = index + coord + ledsInBetween[thisLayer];
if (ledsPerLayer[15-tab] == 6) {
  if (coord == 1 || coord == 2){
    index = index + 1;
  }
  if (coord ==3){
    index = index + 2;
  }
}
if (ledsPerLayer[15-tab] == 5) {
  if (coord == 2 || coord == 3){
    index = index + 1;
  }
}
  return index;
}

void playNote(int index, int coord,int strength) {
  if (coord == 0) { 
     leds[index] = CRGB {0,strength,0}  ;//green 
  }
  if (coord == 1) {
     leds[index] = CRGB {0,0,strength} ;  //blue
  }
    if (coord == 2) {
     leds[index] = CRGB {strength,0,0}  ; //red
  }
    if (coord == 3) {
     leds[index] = CRGB {strength,strength,0} ;  //yellow
  }
   FastLED.show();
   Serial.print("\n lighting up ");
   Serial.print(index);
}





void clearNotes(int index){
    leds[index] = CRGB {0,0,0} ;  //black
    FastLED.show();
}

void setup() {
  // put your setup code here, to run once:
  Serial.begin(9600);
  FastLED.addLeds<WS2812, LED_PIN, GRB>(leds, NUM_LEDS);
}

void loop() {
 // put your main code here, to run repeatedly:
  for (int i = 0; i < songLength; i++){
    note current = mySong[i];
    int thisCoord = current.coord;
    int thisTab = current.tab;
    if(thisCoord < 3){
      int index = sumUp(thisCoord,thisTab);
      playNote(index,thisCoord,128);
      note next = mySong[(i+ 1)%songLength];
      int nextCoord = next.coord;
      int nextTab = next.tab;
      int nextIndex = sumUp(nextCoord,nextTab);
      playNote(nextIndex,nextCoord,4);
    }
    delay(tempo);
    clearNotes(index);
    clearNotes(nextIndex);
  }

  delay(100000);
}
